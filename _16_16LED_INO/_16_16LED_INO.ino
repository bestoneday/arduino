unsigned char txt[][32]=
{
0xFF,0xFF,0x80,0x03,0xFB,0xBF,0xC0,0x07,0xDB,0xB7,0xDB,0xB7,0xC0,0x07,0xFF,0xFF,
0xE0,0x0F,0xEF,0xEF,0xEE,0xEF,0xEE,0xEF,0xEE,0xEF,0xFD,0x9F,0xF3,0xE7,0x8F,0xFB,//贾0

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0xEF,0xFF,0xEF,0xFF,0xFF,0xFF,0xFF,0xFF,0xEF,0xFF,0xEF,0xFF,0xFF,0xFF,0xFF,0xFF//！9

};


class martrix_led
{
  private:
    int row[4];
    int DI;
    int CLK;
    int LATCH;
  public:
  martrix_led(int _A,int _B,int _C,int _D,int _DI,int _CLK,int _LATCH)
  {
    row[0]=_A;
    row[1]=_B;
    row[2]=_C;
    row[3]=_D;
    DI=_DI;
    CLK=_CLK;
    LATCH=_LATCH;
    pinMode(_A,OUTPUT);
    pinMode(_B,OUTPUT);
    pinMode(_C,OUTPUT);
    pinMode(_D,OUTPUT);
    pinMode(DI,OUTPUT);
    pinMode(CLK,OUTPUT);
    pinMode(LATCH,OUTPUT);
    
  }
//-------------------------------------
  void row_choose(int _row)
  {
    int i;
    for(i=0;i<4;i++)
      {
        if(_row%2)
          digitalWrite(row[i],HIGH);
        else
          digitalWrite(row[i],LOW);
        _row/=2;  
      }    
  }
  void row_show(unsigned char val1,unsigned char val2)
  {
    int i;
    for(i=0;i<8;i++)
    { if(val1%2)
        {digitalWrite(DI,HIGH);
         delayMicroseconds(1);
          }
      else
        {digitalWrite(DI,LOW);
        delayMicroseconds(1);
        }
      digitalWrite(CLK,HIGH);
      delayMicroseconds(1);
      digitalWrite(CLK,LOW);
      delayMicroseconds(1);
      val1/=2;
    }
        for(i=0;i<8;i++)
    { if(val2%2)
        {digitalWrite(DI,HIGH);
         delayMicroseconds(1);
          }
      else
        {digitalWrite(DI,LOW);
        delayMicroseconds(1);
        }
      digitalWrite(CLK,HIGH);
      delayMicroseconds(1);
      digitalWrite(CLK,LOW);
      delayMicroseconds(1);
      val2/=2;
    }
    digitalWrite(LATCH,HIGH);
    digitalWrite(LATCH,LOW);
   
  }
  void rewind()
    {
      row_show(0xFF,0xFF);
    }
//------------------------------------------

  void show(unsigned char data[32])
    {
      
      int i;
      for(i=0;i<16;i++)
        {
          rewind();
          row_choose(i);
          row_show(data[i*2+1],data[i*2]);
          delayMicroseconds(50);
        }
    }
};
martrix_led my(8,9,10,11,7,6,5);
int i=0;
void setup()
{
  
}
void loop(){
  
  i=millis()/1000;
  my.show(txt[i%9]);
  
}
